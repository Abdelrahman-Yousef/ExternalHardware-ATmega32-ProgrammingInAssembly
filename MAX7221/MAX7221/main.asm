;
; MAX7221.asm
;
; Created: 12/7/2023 12:52:47 PM
; Author : Options
;


; Replace with your application code
.ORG 0x00
MAIN:
LDI R16,HIGH(RAMEND)
OUT SPH,R16
LDI R16,LOW(RAMEND)
OUT SPL,R16

LDI R16,0xB0
OUT DDRB,R16
SBI PORTB,PB4

LDI R16,0x00
OUT SPSR,R16
LDI R16,0x51  ; mode 0 or mode 3
OUT SPCR,R16


;LDI R16,0x09
;CALL TRANSMIT
;LDI R16,0x03
;CALL TRANSMIT

LDI R16,0x09
CALL TRANSMIT
LDI R16,0x00
CALL TRANSMIT

LDI R16,0x0B
CALL TRANSMIT
LDI R16,0x01
CALL TRANSMIT

LDI R16,0x0C
CALL TRANSMIT
LDI R16,0x01
CALL TRANSMIT

;LDI R16,0x01
;CALL TRANSMIT
;LDI R16,0x07
;CALL TRANSMIT

LDI R16,0x01
CALL TRANSMIT
LDI R16,0x3E
CALL TRANSMIT

;LDI R16,0x02
;CALL TRANSMIT
;LDI R16,0x05
;CALL TRANSMIT

LDI R16,0x02
CALL TRANSMIT
LDI R16,0x6D
CALL TRANSMIT

LOOP: RJMP LOOP


.ORG 0x100
TRANSMIT:
CBI PORTB,PB4
OUT SPDR,R16
HERE:
SBIS SPSR,SPIF
RJMP HERE
SBI PORTB,PB4
RET







