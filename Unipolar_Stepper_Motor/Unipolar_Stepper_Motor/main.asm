;
; Unipolar_Stepper_Motor.asm
;
; Created: 10/12/2023 8:41:59 AM
; Author : Options
;


; Replace with your application code
.INCLUDE "m32def.inc"

.EQU MODE = 0x204
.EQU CONSTANT = 0x01

.ORG 0x00
MAIN:
LDI R16,HIGH(RAMEND)
OUT SPH,R16
LDI R16,LOW(RAMEND)
OUT SPL,R16

LDI R16,0x0F
OUT DDRC,R16

CBI DDRA,PA0
SBI PORTA,PA0

LDI ZL,LOW(MODE << 1)
LDI ZH,HIGH(MODE << 1)

LOOP:
SBIC PINA,PA0
RJMP LOOP
CALL DELAY
SBIC PINA,PA0
RJMP LOOP
CALL ROTATE
HERE:
SBIS PINA,PA0
RJMP HERE

RJMP LOOP


.ORG 0x100
DELAY:
LDI R16,0x64
L1:
LDI R17,0xC8
L2:
DEC R17
BRNE L2
DEC R16
BRNE L1
RET

ROTATE:
LPM R20,Z+
OUT PORTC,R20
CPI R20,CONSTANT
BRNE RETURN
LDI ZL,LOW(MODE << 1)
LDI ZH,HIGH(MODE << 1)
RETURN: RET

.ORG 0x200
WAVE_STEP:
.DB 0x08, 0x04, 0x02, 0x01

FULL_STEP:
.DB 0x09, 0x0C, 0x06, 0x03

HALF_STEP:
.DB 0x09, 0x08, 0x0C, 0x04, 0x06, 0x02, 0x03, 0x01