;
; LCD.asm
;
; Created: 9/11/2023 11:31:11 AM
; Author : Options
;


; Replace with your application code

.INCLUDE "m32def.inc"

.EQU RS = PD0
.EQU RW = PD1
.EQU E  = PD2

.ORG 0x00
MAIN:
LDI R16,HIGH(RAMEND)
OUT SPH,R16
LDI R16,LOW(RAMEND)
OUT SPL,R16

CALL DELAY_40ms

LDI R16,0xFF
OUT DDRC,R16
LDI R16,0x07
OUT DDRD,R16

LDI R16,0x30
CALL SEND_COMMAND
CALL DELAY_40ms

LDI R16,0x30
CALL SEND_COMMAND
CALL DELAY_100us

LDI R16,0x30
CALL SEND_COMMAND
CALL DELAY_100us

LDI R16,0x38
CALL SEND_COMMAND
CALL DELAY_100us

LDI R16,0x0F
CALL SEND_COMMAND
CALL DELAY_100us

LDI R16,0x01
CALL SEND_COMMAND
CALL DELAY_40ms

LDI R16,0x06
CALL SEND_COMMAND
CALL DELAY_100us

LDI R16,0x40
CALL SEND_COMMAND
CALL DELAY_100us

LDI ZL,LOW(CHAR << 1)
LDI ZH,HIGH(CHAR << 1)

DRAW:
LPM R16,Z+
CALL SEND_DATA
CALL DELAY_100us
CPI R16,0x00
BREQ HERE
RJMP DRAW

HERE:
LDI R16,0x80
CALL SEND_COMMAND
CALL DELAY_100us

LDI R16,0x00
CALL SEND_DATA
CALL DELAY_100us


LOOP: RJMP LOOP

.ORG 0x100
DELAY:
NOP
NOP
RET

DELAY_100us:
PUSH R17
LDI R17,60
L1:
CALL DELAY
DEC R17
BRNE L1
POP R17
RET

DELAY_40ms:
PUSH R16
PUSH R17
LDI R16,LOW(0x190)
LDI R17,HIGH(0x190)
L2:
CALL DELAY_100us
SUBI R16,LOW(0x01)
SBCI R17,HIGH(0x01)
BRNE L2
POP R17
POP R16
RET


SEND_COMMAND:
OUT PORTC,R16
CBI PORTD,RW
CBI PORTD,RS
SBI PORTD,E
CALL DELAY
CBI PORTD,E
RET

SEND_DATA:
OUT PORTC,R16
CBI PORTD,RW
SBI PORTD,RS
SBI PORTD,E
CALL DELAY
CBI PORTD,E
RET

CHAR: .DB 0x11, 0x09, 0x05, 0x09, 0x11, 0x09, 0x05, 0x00