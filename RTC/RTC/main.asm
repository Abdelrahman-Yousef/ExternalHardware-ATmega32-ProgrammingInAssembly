;
; RTC.asm
;
; Created: 12/30/2023 9:21:01 AM
; Author : Options
;


; Replace with your application code

.INCLUDE "m32def.inc"

.ORG 0x00
MAIN:
LDI R16,HIGH(RAMEND)
OUT SPH,R16
LDI R16,LOW(RAMEND)
OUT SPL,R16

CALL I2C_INIT

; Write Control Register
CALL I2C_START

LDI R16, (0x68 << 1)
CALL I2C_WRITE

LDI R16,0x07
CALL I2C_WRITE

LDI R16,0x00
CALL I2C_WRITE

CALL I2C_STOP

; Write second, minute and hour registers

CALL I2C_START

LDI R16, (0x68 << 1)
CALL I2C_WRITE

LDI R16,0x00
CALL I2C_WRITE

LDI R16,0x55
CALL I2C_WRITE

LDI R16,0x58
CALL I2C_WRITE

LDI R16,0x16
CALL I2C_WRITE

CALL I2C_STOP

; write date, month, year registers

CALL I2C_START

LDI R16, (0x68 << 1)
CALL I2C_WRITE

LDI R16,0x04
CALL I2C_WRITE

LDI R16,0x19
CALL I2C_WRITE

LDI R16,0x10
CALL I2C_WRITE

LDI R16,0x09
CALL I2C_WRITE

CALL I2C_STOP

; read time and date

CALL I2C_START

LDI R16, (0x68 << 1)
CALL I2C_WRITE

LDI R16,0x00
CALL I2C_WRITE

CALL I2C_START

LDI R16, (0x68 << 1) | (0x01)
CALL I2C_WRITE

CALL I2C_READ_WITH_ACK
IN R17,TWDR

CALL I2C_READ_WITH_ACK
IN R18,TWDR

CALL I2C_READ_WITH_ACK
IN R19,TWDR

CALL I2C_READ_WITH_ACK
IN R20,TWDR

CALL I2C_READ_WITH_ACK
IN R21,TWDR

CALL I2C_READ_WITH_ACK
IN R22,TWDR

CALL I2C_READ_WITH_NOT_ACK
IN R23,TWDR

CALL I2C_STOP

LOOP: RJMP LOOP

.ORG 0x100
I2C_INIT:
LDI R16,0x00
OUT TWSR,R16
LDI R16,0x20
OUT TWBR,R16
RET

I2C_START:
LDI R16,(1 << TWEN) | (1 << TWSTA) | (1 << TWINT)
OUT TWCR,R16
L1:
IN R16,TWCR
SBRS R16,TWINT
RJMP L1
RET

I2C_WRITE:
OUT TWDR,R16
LDI R16,(1 << TWEN) | (1 << TWINT)
OUT TWCR,R16
L2:
IN R16,TWCR
SBRS R16,TWINT
RJMP L2
RET

I2C_READ_WITH_ACK:
LDI R16,(1 << TWEN) | (1 << TWINT) | (1 << TWEA)
OUT TWCR,R16
L3:
IN R16,TWCR
SBRS R16,TWINT
RJMP L3
RET

I2C_READ_WITH_NOT_ACK:
LDI R16,(1 << TWEN) | (1 << TWINT)
OUT TWCR,R16
L4:
IN R16,TWCR
SBRS R16,TWINT
RJMP L4
RET

I2C_STOP:
LDI R16,(1 << TWEN) | (1 << TWSTO) | (1 << TWINT)
OUT TWCR,R16
RET
