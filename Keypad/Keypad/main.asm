;
; Keypad.asm
;
; Created: 9/12/2023 5:17:24 PM
; Author : Options
;


; Replace with your application code
.INCLUDE "m32def.inc"

.ORG 0x00
MAIN:
LDI R16,HIGH(RAMEND)
OUT SPH,R16
LDI R16,LOW(RAMEND)
OUT SPL,R16

LDI R16,0x0F
OUT DDRC,R16
LDI R16,0xFF
OUT DDRD,R16

LOOP:
CALL SCAN
OUT PORTD,R17
RJMP LOOP

.ORG 0x100
SCAN:
LDI R16,0x0F
OUT PORTC,R16
LDI R20,0x00     ; ROW
LDI R16,0x01
OUTER:
COM R16
IN R21,PORTC
AND R21,R16
OUT PORTC,R21
LDI R22,0x00    ; COLUMN
LDI R18,0x01
INNER:
IN R21,PINC
SWAP R21
AND R21,R18
CPI R21,0x00
BREQ GET_KEY_VALUE
INC R22
LSL R18
CPI R22,0x04
BREQ GO_TO_NEXT_ROW
RJMP INNER
GO_TO_NEXT_ROW:
COM R16
IN R21,PORTC
OR R21,R16
OUT PORTC,R21
INC R20
LSL R16
CPI R20,0x04
BREQ RETURN_FROM_SCAN
RJMP OUTER
GET_KEY_VALUE:
LDI ZL,LOW(TABLE << 1)
LDI ZH,HIGH(TABLE << 1)
LDI R21,0x04
MUL R20,R21
MOV R20,R0
ADD R20,R22
LDI R22,0x00
ADD ZL,R20
ADC ZH,R22
LPM R17,Z
RETURN_FROM_SCAN:
RET

TABLE:
.DB '7', '8', '9', '/', '4', '5', '6', '*', '1', '2', '3', '-', ' ', '0', '=', '+'




















