;
; LCD.asm
;
; Created: 9/11/2023 11:31:11 AM
; Author : Options
;


; Replace with your application code

.INCLUDE "m32def.inc"

.EQU RS = PC0
.EQU RW = PC1
.EQU E  = PC2

.ORG 0x00
MAIN:
LDI R16,HIGH(RAMEND)
OUT SPH,R16
LDI R16,LOW(RAMEND)
OUT SPL,R16

CALL DELAY_40ms

LDI R16,0xF7
OUT DDRC,R16


LDI R16,0x33
CALL SEND_COMMAND
CALL DELAY_100us

LDI R16,0x32
CALL SEND_COMMAND
CALL DELAY_100us


LDI R16,0x28
CALL SEND_COMMAND
CALL DELAY_100us

LDI R16,0x28
CALL SEND_COMMAND
CALL DELAY_100us

LDI R16,0x0F
CALL SEND_COMMAND
CALL DELAY_100us

LDI R16,0x01
CALL SEND_COMMAND
CALL DELAY_40ms

LDI R16,0x06
CALL SEND_COMMAND
CALL DELAY_100us

LDI R16,'H'
CALL SEND_DATA
CALL DELAY_100us

LDI R16,'i'
CALL SEND_DATA
CALL DELAY_100us

LOOP: RJMP LOOP


.ORG 0x100
DELAY:
NOP
NOP
RET

DELAY_100us:
PUSH R17
LDI R17,60
L1:
CALL DELAY
DEC R17
BRNE L1
POP R17
RET

DELAY_40ms:
PUSH R16
PUSH R17
LDI R16,LOW(0x190)
LDI R17,HIGH(0x190)
L2:
CALL DELAY_100us
SUBI R16,LOW(0x01)
SBCI R17,HIGH(0x01)
BRNE L2
POP R17
POP R16
RET


SEND_COMMAND:
MOV R20,R16
ANDI R20,0xF0
IN  R21,PORTC
ANDI R21,0x0F
OR R20,R21
OUT PORTC,R20
CBI PORTC,RS
CBI PORTC,RW
SBI PORTC,E
CALL DELAY
CBI PORTC,E

CALL DELAY_100us

MOV R20,R16
SWAP R20
ANDI R20,0xF0
IN  R21,PORTC
ANDI R21,0x0F
OR R20,R21
OUT PORTC,R20
CBI PORTC,RS
CBI PORTC,RW
SBI PORTC,E
CALL DELAY
CBI PORTC,E
RET

SEND_DATA:
MOV R20,R16
ANDI R20,0xF0
IN  R21,PORTC
ANDI R21,0x0F
OR R20,R21
OUT PORTC,R20
SBI PORTC,RS
CBI PORTC,RW
SBI PORTC,E
CALL DELAY
CBI PORTC,E

CALL DELAY_100us

MOV R20,R16
SWAP R20
ANDI R20,0xF0
IN  R21,PORTC
ANDI R21,0x0F
OR R20,R21
OUT PORTC,R20
SBI PORTC,RS
CBI PORTC,RW
SBI PORTC,E
CALL DELAY
CBI PORTC,E
RET









