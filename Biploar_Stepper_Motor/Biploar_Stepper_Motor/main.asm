;
; Biploar_Stepper_Motor.asm
;
; Created: 10/12/2023 5:45:27 PM
; Author : Options
;


; Replace with your application code
.INCLUDE "m32def.inc"

.ORG 0x00
MAIN:
LDI R16,HIGH(RAMEND)
OUT SPH,R16
LDI R16,LOW(RAMEND)
OUT SPL,R16

LDI R16,0x0F
OUT DDRC,R16

CBI DDRA,PA0
SBI PORTA,PA0

LDI ZL,LOW(WAVE_STEP << 1)
LDI ZH,HIGH(WAVE_STEP << 1)

LDI R20,0x00

LOOP:
SBIC PINA,PA0
RJMP L
CALL ROTATE_COUNTER_CLOCKWISE
RJMP D
L: CALL ROTATE_CLOCKWISE
D: CALL DELAY
RJMP LOOP


.ORG 0x100
DELAY:
LDI R16,0xFF
L1:
LDI R17,0xFF
L2:
DEC R17
BRNE L2
DEC R16
BRNE L1
RET

ROTATE_CLOCKWISE:
CPI R20,0x08
BRNE HERE
LDI ZL,LOW(WAVE_STEP << 1)
LDI ZH,HIGH(WAVE_STEP << 1)
HERE:
LPM R20,Z+
OUT PORTC,R20
RET

ROTATE_COUNTER_CLOCKWISE:
CPI R20,0x02
BRNE SKIP
LDI ZL,LOW(((WAVE_STEP + 0x01) << 1) + 0x01) 
LDI ZH,HIGH(((WAVE_STEP + 0x01) << 1) + 0x01)
SKIP:
LPM R20,Z
SBIW ZH:ZL,0x01
OUT PORTC,R20
RET

.ORG 0x200
WAVE_STEP:
.DB 0x02, 0x04, 0x01, 0x08